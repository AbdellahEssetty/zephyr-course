## app/boards/board_scratch/board.yml
```yaml
board:
  name: board_scratch
  full_name: Board Scratch nRF9160 DK
  vendor: iomico
  socs:
  - name: nrf9160
    variants:
    - name: 'ns'
  - name: nrf52840
  revision:
    format: major.minor.patch
    default: "0.14.0"
    revisions:
    - name: "0.7.0"
    - name: "0.14.0"
```

## app/drivers/sensor/Kconfig
```kconfig
config LED_SENSOR
    bool "LED Sensor"
    depends on GPIO && SENSOR
    default y
    help
      Enable the LED sensor driver.
```

## tests/ring_buf/testcase.yaml
```yaml
common:
  tags:
    - unit
    - ring_buf
    - ztest
    - homework

tests:
  homework.unit.ring_buf:
    build_only: false
    platform_allow: 
     - native_sim
     - qemu_x86
    timeout: 60
```

## twister-out/qemu_x86_atom/zephyr/homework.unit.ring_buf/Kconfig/arch/Kconfig
```kconfig
# Load Zephyr Arch Kconfig descriptions.
osource "D:/Users/esset/Documents/VSCode/zephyr/zephyrproject/zephyr/arch/rx/Kconfig"
osource "D:/Users/esset/Documents/VSCode/zephyr/zephyrproject/zephyr/arch/x86/Kconfig"
osource "D:/Users/esset/Documents/VSCode/zephyr/zephyrproject/zephyr/arch/xtensa/Kconfig"
osource "D:/Users/esset/Documents/VSCode/zephyr/zephyrproject/zephyr/arch/sparc/Kconfig"
osource "D:/Users/esset/Documents/VSCode/zephyr/zephyrproject/zephyr/arch/riscv/Kconfig"
osource "D:/Users/esset/Documents/VSCode/zephyr/zephyrproject/zephyr/arch/posix/Kconfig"
osource "D:/Users/esset/Documents/VSCode/zephyr/zephyrproject/zephyr/arch/nios2/Kconfig"
osource "D:/Users/esset/Documents/VSCode/zephyr/zephyrproject/zephyr/arch/mips/Kconfig"
osource "D:/Users/esset/Documents/VSCode/zephyr/zephyrproject/zephyr/arch/arm64/Kconfig"
osource "D:/Users/esset/Documents/VSCode/zephyr/zephyrproject/zephyr/arch/arm/Kconfig"
osource "D:/Users/esset/Documents/VSCode/zephyr/zephyrproject/zephyr/arch/arc/Kconfig"
```
